## Kconfig.ext
```kconfig
# SPDX-License-Identifier: GPL-2.0
# This file is intentionally empty. It's used as a placeholder for when
# KCONFIG_EXT_PREFIX isn't defined.
# Added from SoC
# SPDX-License-Identifier: GPL-2.0

menu  "Exynos SOC require Modules"

config VENDOR_NR_CPUS
	int "Maximum number of CPUs (2-4096) governed by vendor"
	range 2 4096
	default "10"

config SOC_S5E9945
	bool "Samsung S5E9945"
	select ARCH_EXYNOS
	help
	  Support Samsung SOC S5E9945.

config SOC_S5E9955
	bool "Samsung S5E9955"
	select ARCH_EXYNOS
	help
	  Support Samsung SOC S5E9955.

config SOC_S5E8855
	bool "Samsung S5E8855"
	select ARCH_EXYNOS
	help
	  Support Samsung SOC S5E8855.

config EXYNOS_EMULATOR
	bool "Samsung Exynos Emulator"
	select ARCH_EXYNOS
	help
	  Support Samsung Exynos Emulator that has Virtual I/O only.

source "$(KCONFIG_EXT_SOC_PREFIX)drivers/clocksources/Kconfig"

source "$(KCONFIG_EXT_SOC_PREFIX)drivers/tty/serial/Kconfig"

source "$(KCONFIG_EXT_SOC_PREFIX)drivers/i2c/busses/Kconfig"

source "$(KCONFIG_EXT_SOC_PREFIX)drivers/spi/Kconfig"

source "$(KCONFIG_EXT_SOC_PREFIX)drivers/i3c/Kconfig"

source "$(KCONFIG_EXT_SOC_PREFIX)drivers/clk/samsung/Kconfig"

source "$(KCONFIG_EXT_SOC_PREFIX)drivers/soc/samsung/exynos/Kconfig"

source "$(KCONFIG_EXT_SOC_PREFIX)drivers/power/reset/exynos/Kconfig"

source "$(KCONFIG_EXT_SOC_PREFIX)drivers/pinctrl/samsung/Kconfig"

source "$(KCONFIG_EXT_SOC_PREFIX)drivers/iommu/samsung/Kconfig"

source "$(KCONFIG_EXT_SOC_PREFIX)drivers/dma-buf/heaps/samsung/Kconfig"

source "$(KCONFIG_EXT_SOC_PREFIX)drivers/ufs/host/Kconfig"

source "$(KCONFIG_EXT_SOC_PREFIX)drivers/mmc/host/Kconfig"

source "$(KCONFIG_EXT_SOC_PREFIX)drivers/pwm/Kconfig"

source "$(KCONFIG_EXT_SOC_PREFIX)drivers/watchdog/Kconfig"

source "$(KCONFIG_EXT_SOC_PREFIX)drivers/bts/Kconfig"

source "$(KCONFIG_EXT_SOC_PREFIX)drivers/soc/samsung/Kconfig"

source "$(KCONFIG_EXT_SOC_PREFIX)drivers/dma/samsung/Kconfig"

source "$(KCONFIG_EXT_SOC_PREFIX)drivers/devfreq/Kconfig"

source "$(KCONFIG_EXT_SOC_PREFIX)drivers/thermal/Kconfig"

source "$(KCONFIG_EXT_SOC_PREFIX)drivers/dpu/Kconfig"

source "$(KCONFIG_EXT_SOC_PREFIX)drivers/mfd/Kconfig"

source "$(KCONFIG_EXT_SOC_PREFIX)drivers/regulator/Kconfig"

source "$(KCONFIG_EXT_SOC_PREFIX)drivers/rtc/Kconfig"

source "$(KCONFIG_EXT_SOC_PREFIX)drivers/input/keyboard/Kconfig"

source "$(KCONFIG_EXT_SOC_PREFIX)drivers/iio/adc/Kconfig"

source "$(KCONFIG_EXT_SOC_PREFIX)drivers/pinctrl/Kconfig"

source "$(KCONFIG_EXT_SOC_PREFIX)drivers/mfd/samsung/Kconfig"

source "$(KCONFIG_EXT_SOC_PREFIX)drivers/power/supply/samsung/Kconfig"

source "$(KCONFIG_EXT_SOC_PREFIX)drivers/misc/samsung/Kconfig"

source "$(KCONFIG_EXT_SOC_PREFIX)drivers/net/wireless/Kconfig"

source "$(KCONFIG_EXT_SOC_PREFIX)drivers/soc/samsung/exynos/debug/Kconfig"

source "$(KCONFIG_EXT_SOC_PREFIX)drivers/phy/samsung/Kconfig"

source "$(KCONFIG_EXT_SOC_PREFIX)drivers/usb/dwc3/Kconfig"

source "$(KCONFIG_EXT_SOC_PREFIX)drivers/usb/host/Kconfig"

source "$(KCONFIG_EXT_SOC_PREFIX)sound/usb/Kconfig"

source "$(KCONFIG_EXT_SOC_PREFIX)drivers/usb/gadget/function/Kconfig"

source "$(KCONFIG_EXT_SOC_PREFIX)kernel/sched/ems/Kconfig"

source "$(KCONFIG_EXT_SOC_PREFIX)drivers/cpufreq/Kconfig"

source "$(KCONFIG_EXT_SOC_PREFIX)drivers/vision/Kconfig"

source "$(KCONFIG_EXT_SOC_PREFIX)drivers/soc/samsung/exynos/exynos-el2/Kconfig"

source "$(KCONFIG_EXT_SOC_PREFIX)drivers/staging/nanohub/Kconfig"

source "$(KCONFIG_EXT_SOC_PREFIX)drivers/soc/samsung/exynos/exynos-pkvm-module/Kconfig"

source "$(KCONFIG_EXT_SOC_PREFIX)drivers/smfc/Kconfig"

source "$(KCONFIG_EXT_SOC_PREFIX)drivers/mfc/Kconfig"

source "$(KCONFIG_EXT_SOC_PREFIX)drivers/scaler/Kconfig"

source "$(KCONFIG_EXT_SOC_PREFIX)drivers/soc/samsung/exynos/cpif/Kconfig"

source "$(KCONFIG_EXT_SOC_PREFIX)drivers/soc/samsung/exynos/gnssif/Kconfig"

source "$(KCONFIG_EXT_SOC_PREFIX)drivers/clo/Kconfig"

source "$(KCONFIG_EXT_SOC_PREFIX)drivers/pci/controller/dwc/Kconfig"

source "$(KCONFIG_EXT_SOC_PREFIX)sound/soc/samsung/exynos/Kconfig"

source "$(KCONFIG_EXT_SOC_PREFIX)sound/soc/codecs/Kconfig"

source "$(KCONFIG_EXT_SOC_PREFIX)drivers/tsmux/Kconfig"

source "$(KCONFIG_EXT_SOC_PREFIX)drivers/repeater/Kconfig"

source "$(KCONFIG_EXT_SOC_PREFIX)drivers/scsi/Kconfig"

source "$(KCONFIG_EXT_SOC_PREFIX)drivers/irqchip/exynos/Kconfig"

source "$(KCONFIG_EXT_SOC_PREFIX)drivers/block/zram/Kconfig"

source "$(KCONFIG_EXT_SOC_PREFIX)drivers/nfc/samsung/Kconfig"

source "$(KCONFIG_EXT_SOC_PREFIX)mm/sec_mm/Kconfig"

endmenu
# Added from Device
# Removed recursive inclusion - SoC Kconfig.ext already merged
# source "$(KCONFIG_EXT_SOC_PREFIX)Kconfig.ext"

source "$(KCONFIG_EXT_PREFIX)Kconfig.ext_modules"

source "$(KCONFIG_EXT_PREFIX)drivers/samsung/Kconfig"
source "$(KCONFIG_EXT_PREFIX)sound/soc/codecs/Kconfig"
source "$(KCONFIG_EXT_PREFIX)sound/soc/codecs/tas25xx/Kconfig"
source "$(KCONFIG_EXT_PREFIX)sound/soc/samsung/exynos/Kconfig"
source "$(KCONFIG_EXT_PREFIX)sound/soc/samsung/exynos/abox/Kconfig"
source "$(KCONFIG_EXT_PREFIX)drivers/tee/tzdev/Kconfig"
source "$(KCONFIG_EXT_PREFIX)drivers/tee/tui/Kconfig"
source "$(KCONFIG_EXT_PREFIX)drivers/ufs/Kconfig"
source "$(KCONFIG_EXT_PREFIX)drivers/mmc/Kconfig"
source "$(KCONFIG_EXT_PREFIX)drivers/usb/gadget/function/Kconfig"
source "$(KCONFIG_EXT_PREFIX)drivers/camera/Kconfig"
source "$(KCONFIG_EXT_PREFIX)drivers/leds/Kconfig"
source "$(KCONFIG_EXT_PREFIX)block/Kconfig"
source "$(KCONFIG_EXT_PREFIX)drivers/usb/dwc3/Kconfig"
source "$(KCONFIG_EXT_PREFIX)drivers/usb/misc/Kconfig"
source "$(KCONFIG_EXT_PREFIX)drivers/sec_panel_notifier_v2/Kconfig" # ADDED BY LEGO AUTOMATICALLY: DO NOT SUBMIT
source "$(KCONFIG_EXT_PREFIX)drivers/gpu/drm/samsung/panel/tft_common/Kconfig" # ADDED BY LEGO AUTOMATICALLY: DO NOT SUBMIT
source "$(KCONFIG_EXT_PREFIX)drivers/gpu/drm/samsung/panel/tft_common/kunit_test/Kconfig" # ADDED BY LEGO AUTOMATICALLY: DO NOT SUBMIT
source "$(KCONFIG_EXT_PREFIX)drivers/input/sec_input/Kconfig" # ADDED BY LEGO AUTOMATICALLY: DO NOT SUBMIT
source "$(KCONFIG_EXT_PREFIX)drivers/misc/drb/Kconfig" # ADDED BY LEGO AUTOMATICALLY: DO NOT SUBMIT
source "$(KCONFIG_EXT_PREFIX)drivers/muic/common/Kconfig" # ADDED BY LEGO AUTOMATICALLY: DO NOT SUBMIT
source "$(KCONFIG_EXT_PREFIX)drivers/samsung/factory/Kconfig" # ADDED BY LEGO AUTOMATICALLY: DO NOT SUBMIT
source "$(KCONFIG_EXT_PREFIX)drivers/knox/ngksm/Kconfig" # ADDED BY LEGO AUTOMATICALLY: DO NOT SUBMIT
source "$(KCONFIG_EXT_PREFIX)drivers/sti/common/Kconfig" # ADDED BY LEGO AUTOMATICALLY: DO NOT SUBMIT
source "$(KCONFIG_EXT_PREFIX)drivers/usb/notify/Kconfig" # ADDED BY LEGO AUTOMATICALLY: DO NOT SUBMIT
source "$(KCONFIG_EXT_PREFIX)drivers/dpu/panel/Kconfig" # ADDED BY LEGO AUTOMATICALLY: DO NOT SUBMIT
source "$(KCONFIG_EXT_PREFIX)drivers/battery/core/Kconfig" # ADDED BY LEGO AUTOMATICALLY: DO NOT SUBMIT
source "$(KCONFIG_EXT_PREFIX)drivers/staging/android/switch/Kconfig" # ADDED BY LEGO AUTOMATICALLY: DO NOT SUBMIT
source "$(KCONFIG_EXT_PREFIX)drivers/knox/hdm/Kconfig" # ADDED BY LEGO AUTOMATICALLY: DO NOT SUBMIT
source "$(KCONFIG_EXT_PREFIX)drivers/phy/common/Kconfig" # ADDED BY LEGO AUTOMATICALLY: DO NOT SUBMIT
source "$(KCONFIG_EXT_PREFIX)drivers/usb/common/vbus_notifier/Kconfig" # ADDED BY LEGO AUTOMATICALLY: DO NOT SUBMIT
source "$(KCONFIG_EXT_PREFIX)drivers/usb/typec/manager/Kconfig" # ADDED BY LEGO AUTOMATICALLY: DO NOT SUBMIT
source "$(KCONFIG_EXT_PREFIX)drivers/fingerprint/Kconfig" # ADDED BY LEGO AUTOMATICALLY: DO NOT SUBMIT
source "$(KCONFIG_EXT_PREFIX)drivers/knox/kzt/Kconfig" # ADDED BY LEGO AUTOMATICALLY: DO NOT SUBMIT
source "$(KCONFIG_EXT_PREFIX)drivers/battery/charger/sm5714_charger/Kconfig" # ADDED BY LEGO AUTOMATICALLY: DO NOT SUBMIT
source "$(KCONFIG_EXT_PREFIX)drivers/input/input_boost/Kconfig" # ADDED BY LEGO AUTOMATICALLY: DO NOT SUBMIT
source "$(KCONFIG_EXT_PREFIX)drivers/lego/Kconfig" # ADDED BY LEGO AUTOMATICALLY: DO NOT SUBMIT
source "$(KCONFIG_EXT_PREFIX)drivers/gpu/drm/Kconfig" # ADDED BY LEGO AUTOMATICALLY: DO NOT SUBMIT
source "$(KCONFIG_EXT_PREFIX)drivers/gpu/drm/samsung/panel/Kconfig" # ADDED BY LEGO AUTOMATICALLY: DO NOT SUBMIT
source "$(KCONFIG_EXT_PREFIX)drivers/phy/nxp/ptn3222/Kconfig" # ADDED BY LEGO AUTOMATICALLY: DO NOT SUBMIT
source "$(KCONFIG_EXT_PREFIX)drivers/usb/typec/common/Kconfig" # ADDED BY LEGO AUTOMATICALLY: DO NOT SUBMIT
source "$(KCONFIG_EXT_PREFIX)drivers/sti/abc/Kconfig" # ADDED BY LEGO AUTOMATICALLY: DO NOT SUBMIT
source "$(KCONFIG_EXT_PREFIX)drivers/phy/ti/tusb2e11/Kconfig" # ADDED BY LEGO AUTOMATICALLY: DO NOT SUBMIT
source "$(KCONFIG_EXT_PREFIX)drivers/mfd/sm/sm5714/Kconfig" # ADDED BY LEGO AUTOMATICALLY: DO NOT SUBMIT
source "$(KCONFIG_EXT_PREFIX)drivers/input/touchscreen/himax/hx83xxx_spi/Kconfig" # ADDED BY LEGO AUTOMATICALLY: DO NOT SUBMIT
source "$(KCONFIG_EXT_PREFIX)drivers/input/touchscreen/novatek/nt36523_tablet_spi/Kconfig" # ADDED BY LEGO AUTOMATICALLY: DO NOT SUBMIT
source "$(KCONFIG_EXT_PREFIX)drivers/input/misc/hall/Kconfig" # ADDED BY LEGO AUTOMATICALLY: DO NOT SUBMIT
source "$(KCONFIG_EXT_PREFIX)drivers/sensors_lego/Kconfig" # ADDED BY LEGO AUTOMATICALLY: DO NOT SUBMIT
source "$(KCONFIG_EXT_PREFIX)drivers/sensorhub/vendor/Kconfig" # ADDED BY LEGO AUTOMATICALLY: DO NOT SUBMIT
source "$(KCONFIG_EXT_PREFIX)drivers/battery/charger/sm5440_charger/Kconfig" # ADDED BY LEGO AUTOMATICALLY: DO NOT SUBMIT
source "$(KCONFIG_EXT_PREFIX)drivers/input/wacom/Kconfig" # ADDED BY LEGO AUTOMATICALLY: DO NOT SUBMIT
source "$(KCONFIG_EXT_PREFIX)drivers/battery/fuelgauge/sm5714_fuelgauge/Kconfig" # ADDED BY LEGO AUTOMATICALLY: DO NOT SUBMIT
source "$(KCONFIG_EXT_PREFIX)drivers/samsung/pm/sec_thermistor/Kconfig" # ADDED BY LEGO AUTOMATICALLY: DO NOT SUBMIT
source "$(KCONFIG_EXT_PREFIX)drivers/battery/battery_auth/ds28e30/Kconfig" # ADDED BY LEGO AUTOMATICALLY: DO NOT SUBMIT
source "$(KCONFIG_EXT_PREFIX)drivers/battery/common/Kconfig" # ADDED BY LEGO AUTOMATICALLY: DO NOT SUBMIT
source "$(KCONFIG_EXT_PREFIX)drivers/sensorhub/Kconfig" # ADDED BY LEGO AUTOMATICALLY: DO NOT SUBMIT
source "$(KCONFIG_EXT_PREFIX)drivers/sensorhub/debug/Kconfig" # ADDED BY LEGO AUTOMATICALLY: DO NOT SUBMIT
source "$(KCONFIG_EXT_PREFIX)drivers/sensorhub/sensor/Kconfig" # ADDED BY LEGO AUTOMATICALLY: DO NOT SUBMIT
source "$(KCONFIG_EXT_PREFIX)drivers/sensorhub/sensorhub/Kconfig" # ADDED BY LEGO AUTOMATICALLY: DO NOT SUBMIT
source "$(KCONFIG_EXT_PREFIX)drivers/nfc/snvm/Kconfig" # ADDED BY LEGO AUTOMATICALLY: DO NOT SUBMIT
source "$(KCONFIG_EXT_PREFIX)drivers/input/sec_input/stm32/Kconfig" # ADDED BY LEGO AUTOMATICALLY: DO NOT SUBMIT
source "$(KCONFIG_EXT_PREFIX)drivers/battery/battery_auth/sle956681/Kconfig" # ADDED BY LEGO AUTOMATICALLY: DO NOT SUBMIT
source "$(KCONFIG_EXT_PREFIX)drivers/usb/typec/sm/sm5714/Kconfig" # ADDED BY LEGO AUTOMATICALLY: DO NOT SUBMIT
source "$(KCONFIG_EXT_PREFIX)drivers/muic/sm/sm5714/Kconfig" # ADDED BY LEGO AUTOMATICALLY: DO NOT SUBMIT
# External modules moved to Kconfig.ext_modules
```

## drivers/gpu/drm/sgpu/Kconfig
```kconfig
# SPDX-License-Identifier: GPL-2.0

source "drivers/gpu/drm/sgpu/sgpu/Kconfig"
source "drivers/gpu/drm/sgpu/test/Kconfig"
```

## drivers/pinctrl/samsung/Kconfig
```kconfig
# SPDX-License-Identifier: GPL-2.0
#
# Samsung Pin control drivers
#
config PINCTRL_SAMSUNG
	bool
	select GPIOLIB
	select PINMUX
	select PINCONF

config PINCTRL_EXYNOS
	bool "Pinctrl common driver part for Samsung Exynos SoCs"
	depends on ARCH_EXYNOS || ARCH_S5PV210 || (COMPILE_TEST && OF)
	select PINCTRL_SAMSUNG
	select PINCTRL_EXYNOS_ARM if ARM && (ARCH_EXYNOS || ARCH_S5PV210)
	select PINCTRL_EXYNOS_ARM64 if ARM64 && ARCH_EXYNOS

config PINCTRL_EXYNOS_ARM
	bool "ARMv7-specific pinctrl driver for Samsung Exynos SoCs" if COMPILE_TEST
	depends on PINCTRL_EXYNOS

config PINCTRL_EXYNOS_ARM64
	bool "ARMv8-specific pinctrl driver for Samsung Exynos SoCs" if COMPILE_TEST
	depends on PINCTRL_EXYNOS

config PINCTRL_S3C64XX
	bool "Samsung S3C64XX SoC pinctrl driver"
	depends on ARCH_S3C64XX || (COMPILE_TEST && OF)
	select PINCTRL_SAMSUNG

# Added from SoC drivers
# SPDX-License-Identifier: GPL-2.0
#
# Samsung Pin control external drivers
#
config PINCTRL_SAMSUNG_EXT
	tristate "External Pinctrl driver data for Samsung SoCs"
	select GPIOLIB
	select PINMUX
	select PINCONF

config PINCTRL_EXYNOS_EXT
	bool "External Pinctrl common driver part for Samsung Exynos SoCs"
	depends on ARCH_EXYNOS || ARCH_EXYNOS_RISCV || PINCTRL_SAMSUNG_EXT || (COMPILE_TEST && OF)
	select PINCTRL_EXYNOS_EXT_ARM64 if ARCH_EXYNOS && ARM64
	select PINCTRL_EXYNOS_EXT_RISCV if ARCH_EXYNOS_RISCV

config PINCTRL_EXYNOS_EXT_ARM64
	bool "External ARM64 specific pinctrl driver for Samsung Exynos SoCs"
	depends on ARCH_EXYNOS || PINCTRL_SAMSUNG_EXT || (COMPILE_TEST && OF)

config PINCTRL_EXYNOS_EXT_RISCV
	bool "External RISCV specific pinctrl driver for Samsung Exynos SoCs"
	depends on ARCH_EXYNOS_RISCV || PINCTRL_SAMSUNG_EXT || (COMPILE_TEST && OF)

config PINCTRL_SEC_GPIO_DVS
	tristate "Samsung GPIO debugging and verification system"
	depends on SEC_PM && PINCTRL_EXYNOS_ARM64
	default n
```
